// SPDX-License-Identifier: (GPL-2.0-only OR BSD-2-Clause)
/*
 * Device Tree Source for the RZ/V2L Novotech customized board (based on SMARC EVK board)
 *
 * Copyright (C) 2021 Renesas Electronics Corp.
 */
 
/dts-v1/;

#include "r9a07g054l2-rzv2l-novotech.dtsi"

/ {
	memory@48000000 {
		device_type = "memory";
		/* first 128MB is reserved for secure area. */
		reg = <0x0 0x48000000 0x0 0x78000000>;
	};
};
